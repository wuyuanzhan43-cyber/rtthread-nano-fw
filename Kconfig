## src/platform/stm32f407/Kconfig.drivers
```kconfig
# ---------------------------------------------------------------------------
# STM32F407 逐实例外设开关
#
# 每个开关控制一个静态设备实例：
#   FW_USING_UARTn=y -> 编译 serialn、USARTn_IRQHandler，并占用 ring RAM；
#   FW_USING_SPIn=y -> 编译 spin，并配置对应 GPIO/SPI。
#
# 关闭的实例不占 RAM/Flash，也不会生成中断函数。
# 新增实例的引脚/复用功能在 src/platform/board/stm32f407ve/Kconfig.board 中配置；
# 只要打开这里的开关，驱动就会按 Kconfig 自动注册，无需改 C 代码。
# ---------------------------------------------------------------------------
menu "STM32F407 drivers"
    depends on FW_PLATFORM_STM32F407VE

    menu "UART instances"
        # 每个串口设备名固定为 serial1..serial3，与 stm32f407_map.c 一一对应。
        config FW_USING_UART1
            bool "Enable UART1 (serial1)"
            default y
            help
                Build serial1 on USART1. Pins/AF come from board_config.h.
                UART1 is on APB2 and is the default console.

        config FW_USING_UART1_DMA_RX
            bool "UART1 RX DMA"
            depends on FW_USING_UART1
            default n
            help
                Use a circular DMA stream plus the class RX ring instead of
                RXNE interrupts. Reduces per-byte ISR load at high baud rates.

        config FW_USING_UART1_DMA_TX
            bool "UART1 TX DMA"
            depends on FW_USING_UART1
            default n
            help
                Use DMA for TX staging blocks. serial_write still writes the
                class TX ring; the driver peeks a block and starts DMA.

        config FW_USING_UART2
            bool "Enable UART2 (serial2)"
            default n
            help
                Build serial2 on USART2. UART2 is on APB1 and can be used as
                a second console or for HIL while UART1 is busy.

        config FW_USING_UART2_DMA_RX
            bool "UART2 RX DMA"
            depends on FW_USING_UART2
            default n

        config FW_USING_UART2_DMA_TX
            bool "UART2 TX DMA"
            depends on FW_USING_UART2
            default n

        config FW_USING_UART3
            bool "Enable UART3 (serial3)"
            default n
            help
                Build serial3 on USART3. UART3 is on APB1.

        config FW_USING_UART3_DMA_RX
            bool "UART3 RX DMA"
            depends on FW_USING_UART3
            default n

        config FW_USING_UART3_DMA_TX
            bool "UART3 TX DMA"
            depends on FW_USING_UART3
            default n

        # 所有启用 DMA 的 UART 共用这个块大小：
        #   RX 缓冲 = 2 * CHUNK（半传输/全传输各一块）
        #   TX staging = CHUNK
        config FW_SERIAL_DMA_CHUNK
            int "UART DMA chunk bytes"
            default 128
            range 16 1024
            help
                RX uses two chunks (double buffer); TX uses one staging chunk.
                Larger chunks reduce IRQ frequency but add RAM and latency.
    endmenu

    menu "SPI instances"
        # 每个 SPI 设备名固定为 spi1..spi3。
        config FW_USING_SPI1
            bool "Enable SPI1 (spi1)"
            default y
            help
                Build spi1 on SPI1 (APB2). The default ST7735S LCD uses SPI1
                with PA5/PA7 and optional MISO on PA6.

        config FW_USING_SPI1_DMA
            bool "SPI1 DMA"
            depends on FW_USING_SPI1
            default n
            help
                Allocate DMA routes and use DMA for transfers >= 16 bytes.
                TX DMA is always enabled; RX DMA additionally requires
                BOARD_SPI1_USE_MISO. The class exposes async/wait/abort,
                and blocking transfers on the DMA path wait for completion.
                Note: SPI1 MISO (PA6) shares the LCD DC pin on this board,
                so the default SPI1 configuration is TX-only.

        config FW_USING_SPI2
            bool "Enable SPI2 (spi2)"
            default n
            help
                Build spi2 on SPI2 (APB1), default pins PB13/PB14/PB15.
                Enable BOARD_SPI2_USE_MISO if a slave needs MISO.

        config FW_USING_SPI2_DMA
            bool "SPI2 DMA"
            depends on FW_USING_SPI2
            default n
            help
                Allocate DMA routes for SPI2. TX always uses DMA; RX requires
                BOARD_SPI2_USE_MISO. Full-duplex uses two DMA streams.

        config FW_USING_SPI3
            bool "Enable SPI3 (spi3)"
            default n
            help
                Build spi3 on SPI3 (APB1), default pins PC10/PC11/PC12.

        config FW_USING_SPI3_DMA
            bool "SPI3 DMA"
            depends on FW_USING_SPI3
            default n
            help
                Allocate DMA routes for SPI3. TX always uses DMA; RX requires
                BOARD_SPI3_USE_MISO. Full-duplex uses two DMA streams.
    endmenu

    menu "I2C instances"
        # 首版只实现主模式阻塞事务；GPIO 固定为 AF_OD + 内部上拉。
        # 400 kHz 需要板级外部 2.2k–4.7k 上拉。
        config FW_USING_I2C1
            bool "Enable I2C1 (i2c1)"
            default n
            help
                Build i2c1 on I2C1 with PB6/PB7 (AF4). Blocking master only.

        config FW_USING_I2C2
            bool "Enable I2C2 (i2c2)"
            default n
            help
                Build i2c2 on I2C2 with PB10/PB11 (AF4). These pins conflict
                with UART3, so enable only one of them.

        config FW_USING_I2C3
            bool "Enable I2C3 (i2c3)"
            default n
            help
                Build i2c3 on I2C3 with PA8/PC9 (AF4).
    endmenu

    menu "ADC instances"
        config FW_USING_ADC1
            bool "Enable ADC1 (adc1)"
            default n
            help
                Build adc1 on ADC1 with PB0/PB1 (IN8/IN9). Blocking single
                conversion; no DMA or IRQ in the first cut.
    endmenu

    menu "PWM instances"
        config FW_USING_PWM4
            bool "Enable TIM4 PWM (pwm4)"
            default n
            help
                Build pwm4 on TIM4 with PD12..PD15 (AF2), four channels.
                Outputs stay stopped until fw_pwm_start() is called.
    endmenu

    menu "Pin interrupts"
        # EXTI 只由运行时 api 使用：fw_pin_attach_irq/detach_irq/enable_irq。
        # 关闭时 pin 类仍可读写，只是 attach_irq 返回 ENOTSUP。
        config FW_USING_PIN_EXTI
            bool "Enable pin EXTI"
            default n
            help
                Build the SYSCFG/EXTI driver and shared EXTI0..15 handlers.
                The pin class keeps a fixed callback table; callbacks run in
                ISR context and must not block.

        config FW_PIN_IRQ_MAX
            int "Max pin IRQ callbacks"
            default 8
            range 1 32
            help
                Static callback table capacity. One entry per attached pin.
                The hardware still has only 16 EXTI lines.
    endmenu
endmenu
```
