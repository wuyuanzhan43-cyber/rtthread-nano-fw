## Kconfig
```kconfig
# ===========================================================================
# Embedded Framework v2 顶层 Kconfig
#
# 配置入口只有一个：这一棵树。
#   profiles/<name>/defconfig  -> 模板
#   profiles/<name>/.config    -> 当前值
#   profiles/<name>/generated/ -> 生成的头文件/CMake 片段
#
# CMake 与 Keil 都消费同一个 profile，避免两套配置漂移。
# ===========================================================================
mainmenu "Embedded Framework v2 Configuration"

# 项目版本字符串，会出现在生成的配置摘要中；不参与条件判断。
config FW_PROJECT_VERSION
    string
    default "0.2.0"

# 目标平台二选一：
#   HOST            - 在 PC 上跑单元测试，不需要 RTOS/HAL；
#   STM32F407VE     - 真实板卡固件。
# 平台决定后续哪些 menu 可见，以及 CMake 走哪条构建分支。
choice
    prompt "Target platform"
    default FW_PLATFORM_STM32F407VE

config FW_PLATFORM_HOST
    bool "Host unit tests (no RTOS)"

config FW_PLATFORM_STM32F407VE
    bool "STM32F407VE board (RT-Thread Nano)"
endchoice

# 内核参数（调度/IPC/tick/堆）。
source "Kconfig.kernel"
# 自建设备框架的容量与组件开关。
source "Kconfig.framework"
# 应用层业务与启动画面。
source "Kconfig.app"
# 逐实例 UART/SPI 开关（芯片能力）。
source "src/platform/stm32f407/Kconfig.drivers"
# 具体板卡：LED、控制台、引脚映射、LCD。
source "src/platform/board/stm32f407ve/Kconfig.board"
```

## Kconfig.app
```kconfig
# ---------------------------------------------------------------------------
# 应用层配置
#
# 这些选项属于业务/表现层，不属于 framework 或 board。
# 生成到 app_config.h（APP_ 前缀）。
# ---------------------------------------------------------------------------
menu "Application"

# 是否绘制 LCD 启动画面。关闭后 app_boot_display 直接返回 FW_ENOTSUP。
config APP_BOOT_DISPLAY
    bool "Draw LCD boot screen"
    depends on FW_USE_DISPLAY
    default y

# 启动画面三选一：
#   Color bars - 四色横条，用于检查 SPI/窗口/颜色顺序；
#   Avatar     - 128x160 图片，验证整屏位图传输（占 40KB Flash）；
#   White      - 纯白，检查背光和供电。
choice APP_BOOT_SCREEN
    prompt "Boot screen"
    depends on APP_BOOT_DISPLAY
    default APP_BOOT_IMAGE

config APP_BOOT_BARS
    bool "Color bars"

config APP_BOOT_IMAGE
    bool "Avatar image"

config APP_BOOT_WHITE
    bool "White diagnostic"
endchoice

# 隐藏的数值符号，供 app_boot.c 的 #if 使用。
# 最后一条 default 0 保证关闭 APP_BOOT_DISPLAY 时仍有合法值。
config APP_BOOT_MODE
    int
    default 0 if APP_BOOT_BARS
    default 1 if APP_BOOT_IMAGE
    default 2 if APP_BOOT_WHITE
    default 0


# ---------------------------------------------------------------------------
# Task manager / RPC thread
# ---------------------------------------------------------------------------
config APP_RPC_TASK_STACK_SIZE
    int "RPC task stack (bytes)"
    default 2048
    range 512 16384

config APP_RPC_TASK_PRIORITY
    int "RPC task priority"
    default 9
    range 0 31

# RPC 任务等待上限。必须明显小于心跳 warn 阈值，
# 否则任务长时间睡在串口等待里会被误判为心跳超时。
config APP_RPC_LOOP_WAIT_MAX_MS
    int "RPC task max wait (ms)"
    default 500
    range 10 5000

# 可控 worker 任务：用于验证任务控制（0x07 suspend/resume）和
# 多任务健康度/CPU 统计。它不是业务必需的；如果关闭，需要从
# app_task.c 中同时移除对应创建逻辑。
config APP_WORKER_TASK_STACK_SIZE
    int "Worker task stack (bytes)"
    default 1024
    range 512 8192

config APP_WORKER_TASK_PRIORITY
    int "Worker task priority"
    default 12
    range 0 31

config APP_WORKER_PERIOD_MS
    int "Worker loop period (ms)"
    default 100
    range 10 5000

config APP_HEALTH_REFRESH_MS
    int "Health refresh period (ms)"
    default 1000
    range 100 60000

config APP_TASK_HEARTBEAT_WARN_MS
    int "Heartbeat warn threshold (ms)"
    default 1500
    range 100 60000

config APP_TASK_HEARTBEAT_LOST_MS
    int "Heartbeat lost threshold (ms)"
    default 3000
    range 100 120000

config APP_TASK_STACK_WARN_BYTES
    int "Low stack free threshold (bytes)"
    default 256
    range 0 16384


endmenu
```

## Kconfig.framework
```kconfig
# ---------------------------------------------------------------------------
# 自建设备框架配置
#
# 这些符号最终生成到 fw_config.h（FW_*）和 fw_config.cmake（CONFIG_FW_*）。
# 设备类的存在性由构建时的源文件决定；这里控制容量、ring 大小和
# 组件开关。
# ---------------------------------------------------------------------------
menu "Framework"

# 静态设备表容量。每个 serialN/spiN/pin/lcd 都占一个槽位；
# 默认 16 足够当前 3 UART + 3 SPI + pin + lcd，并为扩展留余量。
config FW_DEV_MAX
    int "Max registered devices"
    default 16
    range 1 64

# pin/serial/spi 类的编译开关。
# 当前 v2 固定启用；保留符号是为了让生成头文件与代码中的
# #if FW_USING_* 判断保持一致，也方便以后做裁剪。
config FW_USING_PIN
    bool
    default y

config FW_USING_SERIAL
    bool
    default y

config FW_USING_SPI
    bool
    default y

# 每个串口实例的 RX ring 大小。
# RAM 占用 = 实例数 * (RX + TX)，例如默认 1 个 UART 为 1KB。
# 512 字节可以容纳约 44ms 的 115200bps 数据；如果主循环可能长时间
# 不读串口，应调大。
config FW_SERIAL_RX_BUFSZ
    int "Serial RX ring bytes"
    default 512
    range 32 4096

# 每个串口实例的 TX ring 大小。
# TX 是非阻塞短写；ring 越大，一次 write/协议回复越不容易短写。
config FW_SERIAL_TX_BUFSZ
    int "Serial TX ring bytes"
    default 512
    range 32 4096

# v2 第一版无条件构建协议、demo 应用和显示组件。
# 这些是隐藏符号（没有 prompt），不能通过 menuconfig 修改；
# 保留它们是为了让生成头文件、CMake 和代码中的 #if 判断保持一致。
config FW_USE_PROTOCOL
    bool
    default y
    help
        Hidden switch: the A5 5A protocol component is always built in v2.
        It exists so generated headers, CMake and source #if checks agree.

config FW_USE_DEMO_APP
    bool
    depends on FW_USE_PROTOCOL
    default y
    help
        Hidden switch: the demo application depends on the protocol.
        Disable both together only when replacing the application layer.

config FW_USE_DISPLAY
    bool
    default y
    help
        Hidden switch: display class and ST7735S driver are built in v2.
        BOARD_LCD_ENABLE depends on this symbol.

# 预留给日志等级；当前没有代码消费，保留是为了旧 .config 仍可加载。
config FW_LOG_LEVEL
    int
    default 0
    help
        Reserved. No v2 code reads this value yet; framework logging is
        intentionally not part of the first cut.

endmenu
```

## Kconfig.kernel
```kconfig
# ---------------------------------------------------------------------------
# RT-Thread Nano 内核配置
#
# 只暴露 Nano 实际使用到的内核参数。没有 FinSH/msh、ulog、RT-Thread
# device framework；串口/SPI/GPIO 由本项目的 fw 设备层接管。
#
# 生成的 rtconfig.h 中：
#   - 布尔为 y 时定义 #define RT_xxx 1；
#   - 布尔为 n 的 RT_* 不定义（RT-Thread 源码用 #ifdef 判断）。
# ---------------------------------------------------------------------------
menu "RT-Thread Nano kernel"
    depends on FW_PLATFORM_STM32F407VE

# 内核对象（线程、事件等）名字的最大长度，包含结尾 '\0'。
# 设备名另外由 FW_DEV_NAME_MAX 限制，二者独立。
config RT_NAME_MAX
    int "Max kernel object name length"
    default 8
    range 2 16

# 内存对齐字节数。Cortex-M4 上 8 字节对齐可以让 double/64 位访问
# 满足 AAPCS 要求；本项目没有堆，主要影响线程栈对齐。
config RT_ALIGN_SIZE
    int
    default 8

# 优先级数量。数值越大，可用的优先级层数越多，但就绪表/查找成本略增。
# main 线程默认优先级 10，串口事件等待在 main 中完成。
config RT_THREAD_PRIORITY_MAX
    int "Priority levels"
    default 32
    range 8 256

# 每秒 tick 数。1000Hz -> 1 tick = 1ms，与 HAL 的毫秒时基一致；
# SysTick 重装载值和 HAL_IncTick 的步长都由它推导（见 drv_common.c）。
config RT_TICK_PER_SECOND
    int "Ticks per second"
    default 1000
    range 100 1000

# 使用 RT-Thread 的 main 线程启动流程：rtthread_startup 创建 main 线程，
# 由它调用应用 main()。关闭后需要自己创建入口线程。
config RT_USING_USER_MAIN
    bool
    default y

# main 线程栈大小。当前 main 中只有 RPC 服务和 LCD 初始化，
# 4096 字节留有充足余量；如果加入更多局部大数组需要调大。
config RT_MAIN_THREAD_STACK_SIZE
    int "Main thread stack (bytes)"
    default 4096
    range 512 16384

# main 线程优先级；数值越小优先级越高。10 低于串口事件处理，
# 但仍高于 idle。
config RT_MAIN_THREAD_PRIORITY
    int "Main thread priority"
    default 10
    range 0 31

# idle 线程栈；只运行空闲钩子/回收逻辑，512 字节足够。
config RT_IDLE_THREAD_STACK_SIZE
    int
    default 512

# 启用 rt_kprintf。板级提供了强 rt_hw_console_output，
# 启动横幅和错误日志都依赖它。关闭后 rt_kprintf 变成空操作。
config RT_USING_CONSOLE
    bool "Enable rt_kprintf console"
    default y

# rt_kprintf 的格式化缓冲区大小；日志较长时可适当调大。
config RT_CONSOLEBUF_SIZE
    int
    default 256

# 内核调试检查。打开会增加断言和日志，正式固件默认关闭。
config RT_DEBUG
    bool "Kernel debug checks"
    default n

config RT_DEBUG_INIT
    int
    default 0

# 栈溢出检查：在线程切换时检查栈指针/魔数。
# 代价很小，建议保留，尤其是 main 栈较大时。
config RT_USING_OVERFLOW_CHECK
    bool "Stack overflow check"
    default y

# 信号量：Nano 内部以及未来驱动可能使用；当前串口用事件而非信号量，
# 但保留它可以避免以后加组件时改内核配置。
config RT_USING_SEMAPHORE
    bool
    default y

# 事件：串口 RX 等待使用 rt_event（见 drv_serial.c），必须启用。
config RT_USING_EVENT
    bool
    default y

# 互斥量/邮箱/消息队列：当前项目不使用，关闭以节省代码。
config RT_USING_MUTEX
    bool "Enable mutex IPC"
    default n

config RT_USING_MAILBOX
    bool "Enable mailbox IPC"
    default n

config RT_USING_MESSAGEQUEUE
    bool "Enable message queue IPC"
    default n

# 动态堆：默认关闭，所有线程/事件/设备/ring 都是静态分配。
# 打开后 board.c 会在 _ebss 与保留 MSP 栈之间初始化堆。
config RT_USING_HEAP
    bool "Enable dynamic heap (not recommended)"
    default n
    help
        Off by default: threads, events and devices are static. If enabled,
        board.c initializes a heap between _ebss and the reserved MSP stack.

# 小内存管理算法，仅在启用堆时有意义。
config RT_USING_SMALL_MEM
    bool
    depends on RT_USING_HEAP
    default y

# 静态内存池：当前未使用；需要固定块分配时再打开。
config RT_USING_MEMPOOL
    bool "Enable static memory pool"
    default n
endmenu
```

## profiles/host/defconfig
```kconfig
CONFIG_FW_PLATFORM_HOST=y
CONFIG_FW_DEV_MAX=32
CONFIG_FW_USE_PROTOCOL=y
CONFIG_APP_BOOT_DISPLAY=y
CONFIG_APP_BOOT_IMAGE=y
CONFIG_FW_USE_DISPLAY=y
CONFIG_FW_TASK_MAX=8
CONFIG_FW_USE_TASK=y
CONFIG_APP_RPC_TASK_STACK_SIZE=2048
CONFIG_APP_RPC_TASK_PRIORITY=9
CONFIG_APP_RPC_LOOP_WAIT_MAX_MS=500
CONFIG_APP_HEALTH_REFRESH_MS=1000
CONFIG_APP_TASK_HEARTBEAT_WARN_MS=1500
CONFIG_APP_TASK_HEARTBEAT_LOST_MS=3000
CONFIG_APP_TASK_STACK_WARN_BYTES=256
```
